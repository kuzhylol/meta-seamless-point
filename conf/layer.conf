## conf/layer.conf
```bitbake
# We have a conf and classes directory, add to BBPATH
BBPATH .= ":${LAYERDIR}"

# We have recipes-* directories, add to BBFILES
BBFILES += "${LAYERDIR}/recipes-*/*/*.bb \
            ${LAYERDIR}/recipes-*/*/*.bbappend"

BBFILE_COLLECTIONS += "meta-seamless-point"
BBFILE_PATTERN_meta-seamless-point = "^${LAYERDIR}/"
BBFILE_PRIORITY_meta-seamless-point = "6"

LAYERDEPENDS_meta-seamless-point = "core"
LAYERSERIES_COMPAT_meta-seamless-point = "scarthgap"
```
